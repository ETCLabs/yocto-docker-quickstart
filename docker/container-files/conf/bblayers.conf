## docker/container-files/conf/bblayers.conf
```bitbake
# POKY_BBLAYERS_CONF_VERSION is increased each time build/conf/bblayers.conf
# changes incompatibly
POKY_BBLAYERS_CONF_VERSION = "2"

BBPATH = "${TOPDIR}"
BBFILES ?= ""

BBLAYERS ?= " \
  /opt/yocto/workspace/sources/poky/meta \
  /opt/yocto/workspace/sources/poky/meta-poky \
  /opt/yocto/workspace/sources/poky/meta-yocto-bsp \
  /opt/yocto/workspace/sources/meta-openembedded/meta-oe \
  /opt/yocto/workspace/sources/meta-openembedded/meta-multimedia \
  /opt/yocto/workspace/sources/meta-freescale \
  /opt/yocto/workspace/sources/meta-freescale-3rdparty \
  /opt/yocto/workspace/sources/meta-freescale-distro \
  /opt/yocto/workspace/sources/meta-openembedded/meta-python \
  /opt/yocto/workspace/sources/meta-openembedded/meta-networking \
  /opt/yocto/workspace/sources/meta-cccp \
  "
```
